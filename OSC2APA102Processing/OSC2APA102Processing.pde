/*

  An example sketch for processing in order to control
  The OSC2APA102 Arduino sketch for teensy
  This only uses 1 LED strip - More can be addressed with the /2 and /3 OSC addresses
  
  ¡¡¡ Set the correct serial port for your teensy at the end of the file !!!
  
  CC - BY-SA 3.0 Pascal Baltazar 2018

*/


import processing.serial.*;
import oscP5.*;
import netP5.*;


//define the numbers of LEDs you have here:
int nLEDs = 60;

int brightness = 3;
int dither = 255;

byte[] LEDs = new byte[nLEDs*3];


//define colors for the demos here
color color1, color2;


void setup() {
  size(512, 135);  // Window size
  frameRate(60);
  // List all the available serial ports: - uncomment next line if you don't know you serial device port name
  //printArray(Serial.list()); // uncomment to get the list of devices
  // then copy the name of the desired device as argument to the setupSerial() function below
  setupSerial("/dev/cu.usbmodem3324811");   // Set the correct serial port for your teensy here
  setupDemos();
}


void draw() {
  
  //define colors and values for the demos here (eg. with tweak mode)
  color1 = color(216,255,0);
  color2 = color(255,0,18);
  
  brightness = 3; // setting this low, in order to spare our retinas
  dither = 255;
  
  //_________________________________________________________________________
  // DEMO:
  // This function switches all LEDs when clicking in the window's background
  // and fades LEDs cyclically (with FastLEDs' dither)
  switchWithScreenClick();
  
  // Now, we actually send the values to the LEDs:
  sendLEDs(LEDs, brightness, dither);
}


/************************************************************************************
 DEMOS 
 ************************************************************************************/

PFont f, f2;

int brightFade=0;
int state = 1;

void setupDemos(){
  f = createFont("Geneva", 18);
  f2 = createFont("Geneva", 12);
}


//_________________________________________________________________________  
// This function switches all LEDs when clicking in the window's background
// and fades LEDs cyclically (with FastLEDs' dither)
  
void switchWithScreenClick(){


    for (int i=0; i< nLEDs; i++){
      float interp = (float)i/nLEDs;  
      color c = lerpColor(color1, color2, interp);
      LEDs[3*i]   = (byte)(state*red(c));
      LEDs[3*i+1] = (byte)(state*green(c));
      LEDs[3*i+2] = (byte)(state*blue(c));
      noStroke();
      fill(c);
      rect((float)i/nLEDs*width, 0, width/nLEDs, height);
    }

  //background(state*color1);
  fill((1-state)*(lerpColor(color1, color2, 0.5)));
  //fill((1-state)*color1);
  textFont(f);
  text("click in the background to switch LEDs on and off", 30, 45);
  
 
  if (brightFade<1041){brightFade++;}
  else {brightFade=0;}
  dither = calcDither(brightFade);
  brightness = calcBrightness(brightFade);
  //println(dither);
  
  stroke(0);
  noFill();
  rect(30, 70, 452, 20);
  rect(30, 100, 220, 20);
  rect(262, 100, 220, 20);
  fill(255);
  rect(30, 70, (float)brightFade/1041*452, 20);
  rect(30, 100, (float)dither/255*220, 20);
  rect(262, 100, (float)brightness/31*220, 20);
  fill(127);
  textFont(f2);
  text("Combined brightness level: " + brightFade + " / 1041", 35, 85);
  text("Dither brightness level: " + dither + " / 255", 35, 115);
  text(" APA102 Brightness: " + brightness + " / 31", 267, 115);

}

void mousePressed(){
  state = 1-state;
  
}




/************************************************************************************
  UTILITIES
 ************************************************************************************/

// This part allows to combine APA102's 5 bit brightness and FastLED's 8 bit dither into a ~10 bit combined brightness (see Max patcher for further explanations)

int[] brightnessTable = {0, 1, 1, 1, 1, 1, 1, 1, 1, 1, 1, 1, 1,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 31, 31};
int[] ditherTable = {0, 1, 2, 3, 4, 5, 6, 7, 8, 9, 10, 11, 12,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 254, 255};

int calcBrightness(int combinedBrightness){
  return brightnessTable[combinedBrightness];
}

int calcDither(int combinedBrightness){
  return ditherTable[combinedBrightness];
}


/************************************************************************************
  OSC BUNDLE
 ************************************************************************************/

OscP5 osc;

void sendLEDs(byte[] values, int bright, int ditherBright) {
  
  checkValues(brightness, dither);
  
  /* create an osc bundle */
  OscBundle LEDBundle = new OscBundle();
  
  /* create a new osc message object containing the LED values*/
  OscMessage LEDMessage = new OscMessage("/1");
  LEDMessage.add(values);
  
  /* add the osc message to the osc bundle */
  LEDBundle.add(LEDMessage);
  
   //reset and clear the myMessage object for refill.
  LEDMessage.clear();
  
  // refill the osc message object again, now with the brightness
  LEDMessage.setAddrPattern("/1");
  LEDMessage.add(constrain(bright, 0, 31));
  LEDBundle.add(LEDMessage);
  
  
  // refill the osc message object once again with the dither brightness 
  LEDMessage.clear();
  LEDMessage.setAddrPattern("/b");
  LEDMessage.add(constrain(ditherBright, 0, 255));
  LEDBundle.add(LEDMessage);
  
  serialSend(LEDBundle.getBytes());
  
}



/************************************************************************************
 SLIP ENCODING
 ************************************************************************************/

byte eot = byte(192);
byte slipesc = byte(219);
byte slipescend = byte(220);
byte slipescesc = byte(221);

void slipEncode(byte incoming) {
  if(incoming == eot){ 
    serial.write(slipesc);
    serial.write(slipescend); 
  } else if(incoming==slipesc) {  
    serial.write(slipesc);
    serial.write(slipescesc);
  } else {
    serial.write(incoming);
  }  
}





/************************************************************************************
 SERIAL 
 ************************************************************************************/

//the Serial communcation to the Arduino
Serial serial;

int baud = 9600; // serial port speed
ArrayList<Byte> serialBuffer = new ArrayList<Byte>();

void setupSerial(String portName) {  
 
  // let's actually create the serial port 
  serial = new Serial(this, portName, baud);
}


void serialSend(byte[] data) {
  //println(data);
  //encode the message and send it
  serial.write(eot);
  //println("length: " + data.length);
  for (int i = 0; i < data.length; i++){
     //println("byte #" + i + " is: "+ data[i]);
     slipEncode(data[i]);
  }
  //write the eot
  serial.write(eot);
}